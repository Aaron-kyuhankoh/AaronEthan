## jetson-warrior/build/conf/bblayers.conf
```bitbake
# POKY_BBLAYERS_CONF_VERSION is increased each time build/conf/bblayers.conf
# changes incompatibly
POKY_BBLAYERS_CONF_VERSION = "2"

BBPATH = "${TOPDIR}"
BBFILES ?= ""

BBLAYERS ?= " \
  /projects/jetson-warrior/layers/poky/meta \
  /projects/jetson-warrior/layers/poky/meta-poky \
  /projects/jetson-warrior/layers/poky/meta-yocto-bsp \
  "
```
